## gamestation-master/package/gamestation-romfs/gamestation-romfs-prboom/Config.in
```kconfig
config BR2_PACKAGE_GAMESTATION_ROMFS_PRBOOM
	bool "gamestation-romfs-prboom"
	select BR2_PACKAGE_GAMESTATION_ROMS
	depends on BR2_PACKAGE_LIBRETRO_PRBOOM
	help
	  share_init/roms and xml for prboom
```

## gamestation-master/package/gamestation-romfs/gamestation-romfs-scummvm/Config.in
```kconfig
config BR2_PACKAGE_GAMESTATION_ROMFS_SCUMMVM
	bool "gamestation-romfs-scummvm"
	select BR2_PACKAGE_GAMESTATION_ROMS
	depends on BR2_PACKAGE_SCUMMVM
	help
	  share_init/roms and xml for scummvm
```

## gamestation-master/package/gamestation-romfs/gamestation-romfs-sega32x/Config.in
```kconfig
config BR2_PACKAGE_GAMESTATION_ROMFS_SEGA32X
	bool "gamestation-romfs-sega32x"
	select BR2_PACKAGE_GAMESTATION_ROMS
	depends on BR2_PACKAGE_LIBRETRO_PICODRIVE
	help
	  share_init/roms and xml for sega32x
```

## gamestation-master/package/gamestation-romfs/gamestation-romfs-vectrex/Config.in
```kconfig
config BR2_PACKAGE_GAMESTATION_ROMFS_VECTREX
	bool "gamestation-romfs-vectrex"
	select BR2_PACKAGE_GAMESTATION_ROMS
	depends on BR2_PACKAGE_LIBRETRO_VECX
	help
	  share_init/roms and xml for vectrex
```

## gamestation-master/package/gamestation-romfs/gamestation-romfs-virtualboy/Config.in
```kconfig
config BR2_PACKAGE_GAMESTATION_ROMFS_VIRTUALBOY
	bool "gamestation-romfs-virtualboy"
	select BR2_PACKAGE_GAMESTATION_ROMS
	depends on BR2_PACKAGE_LIBRETRO_BEETLE_VB
	help
	  share_init/roms and xml for virtualboy
```

## gamestation-master/package/gamestation-romfs/gamestation-romfs-wswan/Config.in
```kconfig
config BR2_PACKAGE_GAMESTATION_ROMFS_WSWAN
	bool "gamestation-romfs-wswan"
	select BR2_PACKAGE_GAMESTATION_ROMS
	depends on BR2_PACKAGE_LIBRETRO_BEETLE_WSWAN
	help
	  share_init/roms and xml for wswan
```

## gamestation-master/package/gamestation-romfs/gamestation-romfs-x68000/Config.in
```kconfig
config BR2_PACKAGE_GAMESTATION_ROMFS_X68000
	bool "gamestation-romfs-x68000"
	select BR2_PACKAGE_GAMESTATION_ROMS
	depends on BR2_PACKAGE_LIBRETRO_PX68K
	help
	  share_init/roms and xml for x68000
```

## gamestation-master/package/gamestation-themes/Config.in
```kconfig
config BR2_PACKAGE_GAMESTATION_THEMES
	bool "gamestation ES themes"
	help
	  Emulationstation themes for gamestation.

	  https://gitlab.com/gamestation/gamestation-themes
```

## gamestation-master/package/gamestation-x86_64_efi/Config.in
```kconfig
config BR2_PACKAGE_GAMESTATION_X86_64_EFI
    bool "gamestation-x86_64_efi"
    help
      EFI 64 bit precompiled

      https://github.com/nadenislamarre/gamestation-x86_64_efi
```

## package/gamestation-configgen/Config.in
```kconfig
config BR2_PACKAGE_GAMESTATION_CONFIGGEN
	bool "gamestation configgen"
	select BR2_PACKAGE_PYTHON
	help
	  The configuration utility for gamestation

	  https://gitlab.com/gamestation/gamestation-configgen
```

## package/gamestation-manager/Config.in
```kconfig
config BR2_PACKAGE_GAMESTATION_MANAGER
	bool "gamestation-manager"
	select BR2_PACKAGE_PYTHON_DJANGO
	select BR2_PACKAGE_PYTHON_PSUTIL
	select BR2_PACKAGE_PYTHON_AUTOBREADCRUMBS
	help
	 https://github.com/sveetch/gamestation-manager
```

## package/gamestation-romfs/gamestation-romfs-amiga1200/Config.in
```kconfig
config BR2_PACKAGE_GAMESTATION_ROMFS_AMIGA1200
	bool "gamestation-romfs-amiga1200"
	select BR2_PACKAGE_GAMESTATION_ROMS
	depends on BR2_PACKAGE_AMIBERRY
	help
	  share_init/roms and xml for amiga1200
```

## package/gamestation-romfs/gamestation-romfs-atari2600/Config.in
```kconfig
config BR2_PACKAGE_GAMESTATION_ROMFS_ATARI2600
	bool "gamestation-romfs-atari2600"
	select BR2_PACKAGE_GAMESTATION_ROMS
	depends on BR2_PACKAGE_LIBRETRO_STELLA
	help
	  share_init/roms and xml for atari2600
```

## package/gamestation-romfs/gamestation-romfs-atari800/Config.in
```kconfig
config BR2_PACKAGE_GAMESTATION_ROMFS_ATARI800
	bool "gamestation-romfs-atari800"
	select BR2_PACKAGE_GAMESTATION_ROMS
	depends on BR2_PACKAGE_LIBRETRO_ATARI800
	help
	  share_init/roms and xml for atari800
```

## package/gamestation-romfs/gamestation-romfs-c64/Config.in
```kconfig
config BR2_PACKAGE_GAMESTATION_ROMFS_C64
	bool "gamestation-romfs-c64"
	select BR2_PACKAGE_GAMESTATION_ROMS
	depends on BR2_PACKAGE_LIBRETRO_VICE
	help
	  share_init/roms and xml for c64
```

## package/gamestation-romfs/gamestation-romfs-cavestory/Config.in
```kconfig
config BR2_PACKAGE_GAMESTATION_ROMFS_CAVESTORY
	bool "gamestation-romfs-cavestory"
	select BR2_PACKAGE_GAMESTATION_ROMS
	depends on BR2_PACKAGE_LIBRETRO_NXENGINE
	help
	  share_init/roms and xml for cavestory
```

## package/gamestation-romfs/gamestation-romfs-colecovision/Config.in
```kconfig
config BR2_PACKAGE_GAMESTATION_ROMFS_COLECOVISION
	bool "gamestation-romfs-colecovision"
	select BR2_PACKAGE_GAMESTATION_ROMS
	depends on BR2_PACKAGE_LIBRETRO_BLUEMSX
	help
	  share_init/roms and xml for colecovision
```

## package/gamestation-romfs/gamestation-romfs-dos/Config.in
```kconfig
config BR2_PACKAGE_GAMESTATION_ROMFS_DOS
	bool "gamestation-romfs-dos"
	select BR2_PACKAGE_GAMESTATION_ROMS
	depends on BR2_PACKAGE_DOSBOX
	help
	  share_init/roms and xml for dos
```

## package/gamestation-romfs/gamestation-romfs-fds/Config.in
```kconfig
config BR2_PACKAGE_GAMESTATION_ROMFS_FDS
	bool "gamestation-romfs-fds"
	select BR2_PACKAGE_GAMESTATION_ROMS
	depends on BR2_PACKAGE_LIBRETRO_FCEUMM \
	  || BR2_PACKAGE_LIBRETRO_NESTOPIA
	help
	  share_init/roms and xml for fds
```

## package/gamestation-romfs/gamestation-romfs-gamegear/Config.in
```kconfig
config BR2_PACKAGE_GAMESTATION_ROMFS_GAMEGEAR
	bool "gamestation-romfs-gamegear"
	select BR2_PACKAGE_GAMESTATION_ROMS
	depends on BR2_PACKAGE_LIBRETRO_GENESISPLUSGX
	help
	  share_init/roms and xml for gamegear
```

## package/gamestation-romfs/gamestation-romfs-gba/Config.in
```kconfig
config BR2_PACKAGE_GAMESTATION_ROMFS_GBA
	bool "gamestation-romfs-gba"
	select BR2_PACKAGE_GAMESTATION_ROMS
	depends on BR2_PACKAGE_LIBRETRO_GPSP \
	  || BR2_PACKAGE_LIBRETRO_MGBA \
	  || BR2_PACKAGE_LIBRETRO_METEOR
	help
	  share_init/roms and xml for gba
```

## package/gamestation-romfs/gamestation-romfs-lutro/Config.in
```kconfig
config BR2_PACKAGE_GAMESTATION_ROMFS_LUTRO
	bool "gamestation-romfs-lutro"
	select BR2_PACKAGE_GAMESTATION_ROMS
	depends on BR2_PACKAGE_LIBRETRO_LUTRO
	help
	  share_init/roms and xml for lutro
```

## package/gamestation-romfs/gamestation-romfs-lynx/Config.in
```kconfig
config BR2_PACKAGE_GAMESTATION_ROMFS_LYNX
	bool "gamestation-romfs-lynx"
	select BR2_PACKAGE_GAMESTATION_ROMS
	depends on BR2_PACKAGE_LIBRETRO_HANDY \
	  || BR2_PACKAGE_LIBRETRO_BEETLE_LYNX
	help
	  share_init/roms and xml for lynx
```

## package/gamestation-romfs/gamestation-romfs-mame/Config.in
```kconfig
config BR2_PACKAGE_GAMESTATION_ROMFS_MAME
	bool "gamestation-romfs-mame"
	select BR2_PACKAGE_GAMESTATION_ROMS
	depends on BR2_PACKAGE_LIBRETRO_MAME2003 \
	  || BR2_PACKAGE_LIBRETRO_IMAME \
	  || BR2_PACKAGE_ADVANCEMAME \
	  || BR2_PACKAGE_LIBRETRO_MAME2010
	help
	  share_init/roms and xml for mame
```

## package/gamestation-romfs/gamestation-romfs-megadrive/Config.in
```kconfig
config BR2_PACKAGE_GAMESTATION_ROMFS_MEGADRIVE
	bool "gamestation-romfs-megadrive"
	select BR2_PACKAGE_GAMESTATION_ROMS
	depends on BR2_PACKAGE_LIBRETRO_GENESISPLUSGX \
	  || BR2_PACKAGE_LIBRETRO_PICODRIVE
	help
	  share_init/roms and xml for megadrive
```
