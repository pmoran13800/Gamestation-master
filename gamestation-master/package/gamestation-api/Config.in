## gamestation-master/package/gamestation-api/Config.in
```kconfig
config BR2_PACKAGE_GAMESTATION_API
        bool "gamestation-api"
	depends on BR2_PACKAGE_NODEJS
        help
          Neolao's api project

	  https://github.com/neolao/gamestation-api
```

## gamestation-master/package/gamestation-manager2/Config.in
```kconfig
config BR2_PACKAGE_GAMESTATION_MANAGER2
	bool "gamestation-manager2"
	depends on BR2_PACKAGE_NODEJS
	help
	  A nodejs based web manager
	  https://github.com/djlechuck/gamestation-manager
```

## gamestation-master/package/gamestation-retrogame/Config.in
```kconfig
config BR2_PACKAGE_GAMESTATION_RETROGAME
    bool "gamestation-retrogame"
    help
      Gamestation-retrogame is optimized for Pi2 and manage a 2 player panel with an ESC key
      see https://github.com/ian57/Gamestation-Retrogame-2Players-Pi2 for more on this software
```

## gamestation-master/package/gamestation-romfs/Config.in
```kconfig
# Gamestation-roms main package
 source "$BR2_EXTERNAL_GAMESTATION_PATH/package/gamestation-romfs/gamestation-romfs/Config.in"

menu "Rom dirs and xml"
	 source "$BR2_EXTERNAL_GAMESTATION_PATH/package/gamestation-romfs/gamestation-romfs-amiga600/Config.in"
	 source "$BR2_EXTERNAL_GAMESTATION_PATH/package/gamestation-romfs/gamestation-romfs-amiga1200/Config.in"
	 source "$BR2_EXTERNAL_GAMESTATION_PATH/package/gamestation-romfs/gamestation-romfs-amstradcpc/Config.in"
	 source "$BR2_EXTERNAL_GAMESTATION_PATH/package/gamestation-romfs/gamestation-romfs-apple2/Config.in"
	 source "$BR2_EXTERNAL_GAMESTATION_PATH/package/gamestation-romfs/gamestation-romfs-atari2600/Config.in"
	 source "$BR2_EXTERNAL_GAMESTATION_PATH/package/gamestation-romfs/gamestation-romfs-atari7800/Config.in"
	 source "$BR2_EXTERNAL_GAMESTATION_PATH/package/gamestation-romfs/gamestation-romfs-atarist/Config.in"
	 source "$BR2_EXTERNAL_GAMESTATION_PATH/package/gamestation-romfs/gamestation-romfs-c64/Config.in"
	 source "$BR2_EXTERNAL_GAMESTATION_PATH/package/gamestation-romfs/gamestation-romfs-cavestory/Config.in"
	 source "$BR2_EXTERNAL_GAMESTATION_PATH/package/gamestation-romfs/gamestation-romfs-colecovision/Config.in"
	 source "$BR2_EXTERNAL_GAMESTATION_PATH/package/gamestation-romfs/gamestation-romfs-daphne/Config.in"
	 source "$BR2_EXTERNAL_GAMESTATION_PATH/package/gamestation-romfs/gamestation-romfs-dos/Config.in"
	 source "$BR2_EXTERNAL_GAMESTATION_PATH/package/gamestation-romfs/gamestation-romfs-dreamcast/Config.in"
	 source "$BR2_EXTERNAL_GAMESTATION_PATH/package/gamestation-romfs/gamestation-romfs-fba/Config.in"
	 source "$BR2_EXTERNAL_GAMESTATION_PATH/package/gamestation-romfs/gamestation-romfs-fba_libretro/Config.in"
	 source "$BR2_EXTERNAL_GAMESTATION_PATH/package/gamestation-romfs/gamestation-romfs-fds/Config.in"
	 source "$BR2_EXTERNAL_GAMESTATION_PATH/package/gamestation-romfs/gamestation-romfs-gamecube/Config.in"
	 source "$BR2_EXTERNAL_GAMESTATION_PATH/package/gamestation-romfs/gamestation-romfs-gamegear/Config.in"
	 source "$BR2_EXTERNAL_GAMESTATION_PATH/package/gamestation-romfs/gamestation-romfs-gb/Config.in"
	 source "$BR2_EXTERNAL_GAMESTATION_PATH/package/gamestation-romfs/gamestation-romfs-gba/Config.in"
	 source "$BR2_EXTERNAL_GAMESTATION_PATH/package/gamestation-romfs/gamestation-romfs-gbc/Config.in"
	 source "$BR2_EXTERNAL_GAMESTATION_PATH/package/gamestation-romfs/gamestation-romfs-gw/Config.in"
	 source "$BR2_EXTERNAL_GAMESTATION_PATH/package/gamestation-romfs/gamestation-romfs-imageviewer/Config.in"
	 source "$BR2_EXTERNAL_GAMESTATION_PATH/package/gamestation-romfs/gamestation-romfs-lutro/Config.in"
	 source "$BR2_EXTERNAL_GAMESTATION_PATH/package/gamestation-romfs/gamestation-romfs-lynx/Config.in"
	 source "$BR2_EXTERNAL_GAMESTATION_PATH/package/gamestation-romfs/gamestation-romfs-mame/Config.in"
	 source "$BR2_EXTERNAL_GAMESTATION_PATH/package/gamestation-romfs/gamestation-romfs-mastersystem/Config.in"
	 source "$BR2_EXTERNAL_GAMESTATION_PATH/package/gamestation-romfs/gamestation-romfs-megadrive/Config.in"
	 source "$BR2_EXTERNAL_GAMESTATION_PATH/package/gamestation-romfs/gamestation-romfs-moonlight/Config.in"
	 source "$BR2_EXTERNAL_GAMESTATION_PATH/package/gamestation-romfs/gamestation-romfs-msx/Config.in"
	 source "$BR2_EXTERNAL_GAMESTATION_PATH/package/gamestation-romfs/gamestation-romfs-msx1/Config.in"
	 source "$BR2_EXTERNAL_GAMESTATION_PATH/package/gamestation-romfs/gamestation-romfs-msx2/Config.in"
	 source "$BR2_EXTERNAL_GAMESTATION_PATH/package/gamestation-romfs/gamestation-romfs-n64/Config.in"
	 source "$BR2_EXTERNAL_GAMESTATION_PATH/package/gamestation-romfs/gamestation-romfs-nds/Config.in"
	 source "$BR2_EXTERNAL_GAMESTATION_PATH/package/gamestation-romfs/gamestation-romfs-neogeo/Config.in"
	 source "$BR2_EXTERNAL_GAMESTATION_PATH/package/gamestation-romfs/gamestation-romfs-nes/Config.in"
	 source "$BR2_EXTERNAL_GAMESTATION_PATH/package/gamestation-romfs/gamestation-romfs-ngp/Config.in"
	 source "$BR2_EXTERNAL_GAMESTATION_PATH/package/gamestation-romfs/gamestation-romfs-ngpc/Config.in"
	 source "$BR2_EXTERNAL_GAMESTATION_PATH/package/gamestation-romfs/gamestation-romfs-o2em/Config.in"
	 source "$BR2_EXTERNAL_GAMESTATION_PATH/package/gamestation-romfs/gamestation-romfs-pcengine/Config.in"
	 source "$BR2_EXTERNAL_GAMESTATION_PATH/package/gamestation-romfs/gamestation-romfs-pcenginecd/Config.in"
	 source "$BR2_EXTERNAL_GAMESTATION_PATH/package/gamestation-romfs/gamestation-romfs-prboom/Config.in"
	 source "$BR2_EXTERNAL_GAMESTATION_PATH/package/gamestation-romfs/gamestation-romfs-psp/Config.in"
	 source "$BR2_EXTERNAL_GAMESTATION_PATH/package/gamestation-romfs/gamestation-romfs-psx/Config.in"
	 source "$BR2_EXTERNAL_GAMESTATION_PATH/package/gamestation-romfs/gamestation-romfs-scummvm/Config.in"
	 source "$BR2_EXTERNAL_GAMESTATION_PATH/package/gamestation-romfs/gamestation-romfs-sega32x/Config.in"
	 source "$BR2_EXTERNAL_GAMESTATION_PATH/package/gamestation-romfs/gamestation-romfs-segacd/Config.in"
	 source "$BR2_EXTERNAL_GAMESTATION_PATH/package/gamestation-romfs/gamestation-romfs-sg1000/Config.in"
	 source "$BR2_EXTERNAL_GAMESTATION_PATH/package/gamestation-romfs/gamestation-romfs-snes/Config.in"
	 source "$BR2_EXTERNAL_GAMESTATION_PATH/package/gamestation-romfs/gamestation-romfs-supergrafx/Config.in"
	 source "$BR2_EXTERNAL_GAMESTATION_PATH/package/gamestation-romfs/gamestation-romfs-vectrex/Config.in"
	 source "$BR2_EXTERNAL_GAMESTATION_PATH/package/gamestation-romfs/gamestation-romfs-virtualboy/Config.in"
	 source "$BR2_EXTERNAL_GAMESTATION_PATH/package/gamestation-romfs/gamestation-romfs-wii/Config.in"
	 source "$BR2_EXTERNAL_GAMESTATION_PATH/package/gamestation-romfs/gamestation-romfs-wswan/Config.in"
	 source "$BR2_EXTERNAL_GAMESTATION_PATH/package/gamestation-romfs/gamestation-romfs-wswanc/Config.in"
	 source "$BR2_EXTERNAL_GAMESTATION_PATH/package/gamestation-romfs/gamestation-romfs-x68000/Config.in"
	 source "$BR2_EXTERNAL_GAMESTATION_PATH/package/gamestation-romfs/gamestation-romfs-zx81/Config.in"
	 source "$BR2_EXTERNAL_GAMESTATION_PATH/package/gamestation-romfs/gamestation-romfs-zxspectrum/Config.in"
	 source "$BR2_EXTERNAL_GAMESTATION_PATH/package/gamestation-romfs/gamestation-romfs-3do/Config.in"
	 source "$BR2_EXTERNAL_GAMESTATION_PATH/package/gamestation-romfs/gamestation-romfs-thomson/Config.in"
	 source "$BR2_EXTERNAL_GAMESTATION_PATH/package/gamestation-romfs/gamestation-romfs-atari5200/Config.in"
	 source "$BR2_EXTERNAL_GAMESTATION_PATH/package/gamestation-romfs/gamestation-romfs-atari800/Config.in"
endmenu
```

## gamestation-master/package/gamestation-romfs/gamestation-romfs-amiga600/Config.in
```kconfig
config BR2_PACKAGE_GAMESTATION_ROMFS_AMIGA600
	bool "gamestation-romfs-amiga600"
	select BR2_PACKAGE_GAMESTATION_ROMS
	depends on BR2_PACKAGE_AMIBERRY
	help
	  share_init/roms and xml for amiga600
```

## gamestation-master/package/gamestation-romfs/gamestation-romfs-amstradcpc/Config.in
```kconfig
config BR2_PACKAGE_GAMESTATION_ROMFS_AMSTRADCPC
	bool "gamestation-romfs-amstradcpc"
	select BR2_PACKAGE_GAMESTATION_ROMS
	depends on BR2_PACKAGE_LIBRETRO_CAP32 \
	  || BR2_PACKAGE_LIBRETRO_CROCODS
	help
	  share_init/roms and xml for amstradcpc
```

## gamestation-master/package/gamestation-romfs/gamestation-romfs-apple2/Config.in
```kconfig
config BR2_PACKAGE_GAMESTATION_ROMFS_APPLE2
	bool "gamestation-romfs-apple2"
	select BR2_PACKAGE_GAMESTATION_ROMS
	depends on BR2_PACKAGE_LINAPPLE_PIE
	help
	  share_init/roms and xml for apple2
```

## gamestation-master/package/gamestation-romfs/gamestation-romfs-atari5200/Config.in
```kconfig
config BR2_PACKAGE_GAMESTATION_ROMFS_ATARI5200
        bool "gamestation-romfs-atari5200"
        select BR2_PACKAGE_GAMESTATION_ROMS
        depends on BR2_PACKAGE_LIBRETRO_ATARI800
        help
          share_init/roms and xml for Atari 5200
          
```

## gamestation-master/package/gamestation-romfs/gamestation-romfs-atari7800/Config.in
```kconfig
config BR2_PACKAGE_GAMESTATION_ROMFS_ATARI7800
	bool "gamestation-romfs-atari7800"
	select BR2_PACKAGE_GAMESTATION_ROMS
	depends on BR2_PACKAGE_LIBRETRO_PROSYSTEM
	help
	  share_init/roms and xml for atari7800
```

## gamestation-master/package/gamestation-romfs/gamestation-romfs-atarist/Config.in
```kconfig
config BR2_PACKAGE_GAMESTATION_ROMFS_ATARIST
	bool "gamestation-romfs-atarist"
	select BR2_PACKAGE_GAMESTATION_ROMS
	depends on BR2_PACKAGE_LIBRETRO_HATARI
	help
	  share_init/roms and xml for atarist
```

## gamestation-master/package/gamestation-romfs/gamestation-romfs-daphne/Config.in
```kconfig
config BR2_PACKAGE_GAMESTATION_ROMFS_DAPHNE
	bool "gamestation-romfs-daphne"
	select BR2_PACKAGE_GAMESTATION_ROMS
	depends on BR2_PACKAGE_HYPSEUS
	help
	  share_init/roms and xml for Hypseus (Daphne fork)
```

## gamestation-master/package/gamestation-romfs/gamestation-romfs-dreamcast/Config.in
```kconfig
config BR2_PACKAGE_GAMESTATION_ROMFS_DREAMCAST
	bool "gamestation-romfs-dreamcast"
	select BR2_PACKAGE_GAMESTATION_ROMS
	depends on BR2_PACKAGE_REICAST
	help
	  share_init/roms and xml for dreamcast
```

## gamestation-master/package/gamestation-romfs/gamestation-romfs-fba/Config.in
```kconfig
config BR2_PACKAGE_GAMESTATION_ROMFS_FBA
	bool "gamestation-romfs-fba"
	select BR2_PACKAGE_GAMESTATION_ROMS
	depends on BR2_PACKAGE_PIFBA
	help
	  share_init/roms and xml for fba
```

## gamestation-master/package/gamestation-romfs/gamestation-romfs-fba_libretro/Config.in
```kconfig
config BR2_PACKAGE_GAMESTATION_ROMFS_FBA_LIBRETRO
	bool "gamestation-romfs-fba_libretro"
	select BR2_PACKAGE_GAMESTATION_ROMS
	depends on BR2_PACKAGE_LIBRETRO_FBA
	help
	  share_init/roms and xml for fba_libretro
```

## gamestation-master/package/gamestation-romfs/gamestation-romfs-gamecube/Config.in
```kconfig
config BR2_PACKAGE_GAMESTATION_ROMFS_GAMECUBE
	bool "gamestation-romfs-gamecube"
	select BR2_PACKAGE_GAMESTATION_ROMS
	depends on BR2_PACKAGE_DOLPHIN_EMU
	help
	  share_init/roms and xml for gamecube
```

## gamestation-master/package/gamestation-romfs/gamestation-romfs-gb/Config.in
```kconfig
config BR2_PACKAGE_GAMESTATION_ROMFS_GB
	bool "gamestation-romfs-gb"
	select BR2_PACKAGE_GAMESTATION_ROMS
	depends on BR2_PACKAGE_LIBRETRO_GAMBATTE \
	  || BR2_PACKAGE_LIBRETRO_TGBDUAL \
	  || BR2_PACKAGE_LIBRETRO_MGBA
	help
	  share_init/roms and xml for gb
```

## gamestation-master/package/gamestation-romfs/gamestation-romfs-gbc/Config.in
```kconfig
config BR2_PACKAGE_GAMESTATION_ROMFS_GBC
	bool "gamestation-romfs-gbc"
	select BR2_PACKAGE_GAMESTATION_ROMS
	depends on BR2_PACKAGE_LIBRETRO_GAMBATTE \
	  || BR2_PACKAGE_LIBRETRO_TGBDUAL \
	  || BR2_PACKAGE_LIBRETRO_MGBA
	help
	  share_init/roms and xml for gbc
```

## gamestation-master/package/gamestation-romfs/gamestation-romfs-gw/Config.in
```kconfig
config BR2_PACKAGE_GAMESTATION_ROMFS_GW
	bool "gamestation-romfs-gw"
	select BR2_PACKAGE_GAMESTATION_ROMS
	depends on BR2_PACKAGE_LIBRETRO_GW
	help
	  share_init/roms and xml for gw
```

## gamestation-master/package/gamestation-romfs/gamestation-romfs-imageviewer/Config.in
```kconfig
config BR2_PACKAGE_GAMESTATION_ROMFS_IMAGEVIEWER
	bool "gamestation-romfs-imageviewer"
	select BR2_PACKAGE_GAMESTATION_ROMS
	depends on BR2_PACKAGE_RETROARCH
	help
	  share_init/roms and xml for imageviewer
```

## gamestation-master/package/gamestation-romfs/gamestation-romfs-mastersystem/Config.in
```kconfig
config BR2_PACKAGE_GAMESTATION_ROMFS_MASTERSYSTEM
	bool "gamestation-romfs-mastersystem"
	select BR2_PACKAGE_GAMESTATION_ROMS
	depends on BR2_PACKAGE_LIBRETRO_GENESISPLUSGX \
	  || BR2_PACKAGE_LIBRETRO_PICODRIVE
	help
	  share_init/roms and xml for mastersystem
```

## gamestation-master/package/gamestation-romfs/gamestation-romfs-msx1/Config.in
```kconfig
config BR2_PACKAGE_GAMESTATION_ROMFS_MSX1
	bool "gamestation-romfs-msx1"
	select BR2_PACKAGE_GAMESTATION_ROMS
	depends on BR2_PACKAGE_LIBRETRO_BLUEMSX \
	  || BR2_PACKAGE_LIBRETRO_FMSX
	help
	  share_init/roms and xml for msx1
```

## gamestation-master/package/gamestation-romfs/gamestation-romfs-msx2/Config.in
```kconfig
config BR2_PACKAGE_GAMESTATION_ROMFS_MSX2
	bool "gamestation-romfs-msx2"
	select BR2_PACKAGE_GAMESTATION_ROMS
	depends on BR2_PACKAGE_LIBRETRO_BLUEMSX \
	  || BR2_PACKAGE_LIBRETRO_FMSX
	help
	  share_init/roms and xml for msx2
```

## gamestation-master/package/gamestation-romfs/gamestation-romfs-nds/Config.in
```kconfig
config BR2_PACKAGE_GAMESTATION_ROMFS_NDS
	bool "gamestation-romfs-nds"
	select BR2_PACKAGE_GAMESTATION_ROMS
	depends on BR2_PACKAGE_LIBRETRO_DESMUME \
	  || BR2_PACKAGE_LIBRETRO_MELONDS
	help
	  share_init/roms and xml for nds
```

## gamestation-master/package/gamestation-romfs/gamestation-romfs-ngp/Config.in
```kconfig
config BR2_PACKAGE_GAMESTATION_ROMFS_NGP
	bool "gamestation-romfs-ngp"
	select BR2_PACKAGE_GAMESTATION_ROMS
	depends on BR2_PACKAGE_LIBRETRO_BEETLE_NGP
	help
	  share_init/roms and xml for ngp
```

## gamestation-master/package/gamestation-romfs/gamestation-romfs-o2em/Config.in
```kconfig
config BR2_PACKAGE_GAMESTATION_ROMFS_O2EM
	bool "gamestation-romfs-o2em"
	select BR2_PACKAGE_GAMESTATION_ROMS
	depends on BR2_PACKAGE_LIBRETRO_O2EM
	help
	  share_init/roms and xml for o2em
```
