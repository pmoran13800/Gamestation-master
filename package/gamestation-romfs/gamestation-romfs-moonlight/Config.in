## package/gamestation-romfs/gamestation-romfs-moonlight/Config.in
```kconfig
config BR2_PACKAGE_GAMESTATION_ROMFS_MOONLIGHT
	bool "gamestation-romfs-moonlight"
	select BR2_PACKAGE_GAMESTATION_ROMS
	depends on BR2_PACKAGE_MOONLIGHT_EMBEDDED
	help
	  share_init/roms and xml for moonlight
```

## package/gamestation-romfs/gamestation-romfs-msx/Config.in
```kconfig
config BR2_PACKAGE_GAMESTATION_ROMFS_MSX
	bool "gamestation-romfs-msx"
	select BR2_PACKAGE_GAMESTATION_ROMS
	depends on BR2_PACKAGE_LIBRETRO_BLUEMSX \
	  || BR2_PACKAGE_LIBRETRO_FMSX
	help
	  share_init/roms and xml for msx
```

## package/gamestation-romfs/gamestation-romfs-n64/Config.in
```kconfig
config BR2_PACKAGE_GAMESTATION_ROMFS_N64
	bool "gamestation-romfs-n64"
	select BR2_PACKAGE_GAMESTATION_ROMS
	depends on BR2_PACKAGE_MUPEN64PLUS_GLIDEN64 \
	  || BR2_PACKAGE_MUPEN64PLUS_GLES2 \
	  || BR2_PACKAGE_MUPEN64PLUS_GLES2RICE \
	  || BR2_PACKAGE_MUPEN64PLUS_VIDEO_GLIDE64MK2 \
	  || BR2_PACKAGE_LIBRETRO_GLUPEN64
	help
	  share_init/roms and xml for n64
```

## package/gamestation-romfs/gamestation-romfs-neogeo/Config.in
```kconfig
config BR2_PACKAGE_GAMESTATION_ROMFS_NEOGEO
	bool "gamestation-romfs-neogeo"
	select BR2_PACKAGE_GAMESTATION_ROMS
	depends on BR2_PACKAGE_LIBRETRO_MAME2003 \
	  || BR2_PACKAGE_LIBRETRO_IMAME \
	  || BR2_PACKAGE_LIBRETRO_FBA \
	  || BR2_PACKAGE_PIFBA \
	  || BR2_PACKAGE_LIBRETRO_MAME2010
	help
	  share_init/roms and xml for neogeo
```

## package/gamestation-romfs/gamestation-romfs-nes/Config.in
```kconfig
config BR2_PACKAGE_GAMESTATION_ROMFS_NES
	bool "gamestation-romfs-nes"
	select BR2_PACKAGE_GAMESTATION_ROMS
	depends on BR2_PACKAGE_LIBRETRO_FCEUMM \
	  || BR2_PACKAGE_LIBRETRO_FCEUNEXT \
	  || BR2_PACKAGE_LIBRETRO_NESTOPIA \
	  || BR2_PACKAGE_LIBRETRO_QUICKNES
	help
	  share_init/roms and xml for nes
```

## package/gamestation-romfs/gamestation-romfs-pcengine/Config.in
```kconfig
config BR2_PACKAGE_GAMESTATION_ROMFS_PCENGINE
	bool "gamestation-romfs-pcengine"
	select BR2_PACKAGE_GAMESTATION_ROMS
	depends on BR2_PACKAGE_LIBRETRO_BEETLE_SUPERGRAFX \
	  || BR2_PACKAGE_LIBRETRO_BEETLE_PCE
	help
	  share_init/roms and xml for pcengine
```

## package/gamestation-romfs/gamestation-romfs-pcenginecd/Config.in
```kconfig
config BR2_PACKAGE_GAMESTATION_ROMFS_PCENGINECD
	bool "gamestation-romfs-pcenginecd"
	select BR2_PACKAGE_GAMESTATION_ROMS
	depends on BR2_PACKAGE_LIBRETRO_BEETLE_SUPERGRAFX \
	  || BR2_PACKAGE_LIBRETRO_BEETLE_PCE
	help
	  share_init/roms and xml for pcenginecd
```

## package/gamestation-romfs/gamestation-romfs-psp/Config.in
```kconfig
config BR2_PACKAGE_GAMESTATION_ROMFS_PSP
	bool "gamestation-romfs-psp"
	select BR2_PACKAGE_GAMESTATION_ROMS
	depends on BR2_PACKAGE_PPSSPP
	help
	  share_init/roms and xml for psp
```

## package/gamestation-romfs/gamestation-romfs-psx/Config.in
```kconfig
config BR2_PACKAGE_GAMESTATION_ROMFS_PSX
	bool "gamestation-romfs-psx"
	select BR2_PACKAGE_GAMESTATION_ROMS
	depends on BR2_PACKAGE_LIBRETRO_PCSX \
	  || BR2_PACKAGE_LIBRETRO_BEETLE_PSX \
	  || BR2_PACKAGE_LIBRETRO_BEETLE_PSX_HW
	help
	  share_init/roms and xml for psx
```

## package/gamestation-romfs/gamestation-romfs-segacd/Config.in
```kconfig
config BR2_PACKAGE_GAMESTATION_ROMFS_SEGACD
	bool "gamestation-romfs-segacd"
	select BR2_PACKAGE_GAMESTATION_ROMS
	depends on BR2_PACKAGE_LIBRETRO_GENESISPLUSGX \
	  || BR2_PACKAGE_LIBRETRO_PICODRIVE
	help
	  share_init/roms and xml for segacd
```

## package/gamestation-romfs/gamestation-romfs-sg1000/Config.in
```kconfig
config BR2_PACKAGE_GAMESTATION_ROMFS_SG1000
	bool "gamestation-romfs-sg1000"
	select BR2_PACKAGE_GAMESTATION_ROMS
	depends on BR2_PACKAGE_LIBRETRO_GENESISPLUSGX
	help
	  share_init/roms and xml for sg1000
```

## package/gamestation-romfs/gamestation-romfs-snes/Config.in
```kconfig
config BR2_PACKAGE_GAMESTATION_ROMFS_SNES
	bool "gamestation-romfs-snes"
	select BR2_PACKAGE_GAMESTATION_ROMS
	depends on BR2_PACKAGE_LIBRETRO_CATSFC \
	  || BR2_PACKAGE_LIBRETRO_POCKETSNES \
	  || BR2_PACKAGE_LIBRETRO_SNES9X_NEXT \
	  || BR2_PACKAGE_LIBRETRO_SNES9X
	help
	  share_init/roms and xml for snes
```

## package/gamestation-romfs/gamestation-romfs-supergrafx/Config.in
```kconfig
config BR2_PACKAGE_GAMESTATION_ROMFS_SUPERGRAFX
	bool "gamestation-romfs-supergrafx"
	select BR2_PACKAGE_GAMESTATION_ROMS
	depends on BR2_PACKAGE_LIBRETRO_BEETLE_SUPERGRAFX \
	  || BR2_PACKAGE_LIBRETRO_BEETLE_PCE
	help
	  share_init/roms and xml for supergrafx
```

## package/gamestation-romfs/gamestation-romfs-thomson/Config.in
```kconfig
config BR2_PACKAGE_GAMESTATION_ROMFS_THOMSON
	bool "gamestation-romfs-thomson"
	select BR2_PACKAGE_GAMESTATION_ROMS
	depends on BR2_PACKAGE_LIBRETRO_THEODORE
	help
	  share_init/roms and xml for thomson
```

## package/gamestation-romfs/gamestation-romfs-wii/Config.in
```kconfig
config BR2_PACKAGE_GAMESTATION_ROMFS_WII
	bool "gamestation-romfs-wii"
	select BR2_PACKAGE_GAMESTATION_ROMS
	depends on BR2_PACKAGE_DOLPHIN_EMU
	help
	  share_init/roms and xml for wii
```

## package/gamestation-romfs/gamestation-romfs-wswanc/Config.in
```kconfig
config BR2_PACKAGE_GAMESTATION_ROMFS_WSWANC
	bool "gamestation-romfs-wswanc"
	select BR2_PACKAGE_GAMESTATION_ROMS
	depends on BR2_PACKAGE_LIBRETRO_BEETLE_WSWAN
	help
	  share_init/roms and xml for wswanc
```

## package/gamestation-romfs/gamestation-romfs-zx81/Config.in
```kconfig
config BR2_PACKAGE_GAMESTATION_ROMFS_ZX81
	bool "gamestation-romfs-zx81"
	select BR2_PACKAGE_GAMESTATION_ROMS
	depends on BR2_PACKAGE_LIBRETRO_81
	help
	  share_init/roms and xml for zx81
```
